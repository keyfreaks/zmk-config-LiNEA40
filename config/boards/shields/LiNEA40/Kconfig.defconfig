## config/boards/shields/LiNEA40/Kconfig.defconfig
```kconfig
if SHIELD_LiNEA40_RIGHT
    config ZMK_KEYBOARD_NAME
        default "keyFreaksLiNEA40"
    config ZMK_SPLIT_ROLE_CENTRAL
        default y
endif

if SHIELD_LiNEA40_LEFT || SHIELD_LiNEA40_RIGHT
    config ZMK_SPLIT
        default y
endif
```

## config/west.yml
```yaml
# LiNEA40 の依存一覧 (DYA Studio 対応 / ZMK v0.4 系 / Zephyr 4.1)
# 構成の参考: DYA Studio 開発者ガイド (Level 2)、sayu-hub/zmk-config-moNa2-v2
# revision は、ビルドを確認した時点のコミットに固定している。
# 行末の "# track:" は、更新するときに追いかけるブランチ名。
manifest:
  remotes:
    - name: zmkfirmware
      url-base: https://github.com/zmkfirmware
    - name: cormoran
      url-base: https://github.com/cormoran
    - name: caksoylar
      url-base: https://github.com/caksoylar
  projects:
    # ==== ZMK 本体 (独自 Studio RPC に対応した cormoran 版) ====
    # Zephyr は上書きせず、zmk/app/west.yml が指定する zmkfirmware/zephyr v4.1.0+zmk-fixes を使う
    - name: zmk
      remote: cormoran
      revision: e5c9b6915b56801193e359dd9bad4a167ce0d1b8  # track: main+dya
      import: app/west.yml

    # ==== コア (設定基盤 / キーマップ高速読み込み) ====
    - name: zmk-feature-custom-settings
      remote: cormoran
      revision: c6a7fef3a3be3d3ace5de9a4b0628c6418cd1f3f  # track: main
    - name: zmk-feature-fast-keymap
      remote: cormoran
      revision: 21d9af3c2ad694f823ad007b361b091c1e366eee  # track: main

    # ==== Keymap / Macro / Combo タブ ====
    - name: zmk-behavior-runtime-sensor-rotate
      remote: cormoran
      revision: 8b1125ed676c1f5e14145d217984f33d0ebdcef4  # track: main
    - name: zmk-feature-runtime-combo
      remote: cormoran
      revision: d9490e7b5d41c516221d131241009e81740efcee  # track: main
    - name: zmk-feature-runtime-macro
      remote: cormoran
      revision: 38530962eb7061b60efcb98e84585cfb1f0cb6de  # track: main
    - name: zmk-feature-runtime-tapdance
      remote: cormoran
      revision: 3ed2c36ed94b16601eeba2ed39a27cc93e9a53ee  # track: main
    - name: zmk-feature-input-stream
      remote: cormoran
      revision: aeb015908a42a7615ccdccc7feb3a10d23132a71  # track: main

    # ==== Trackball タブ ====
    - name: zmk-driver-pmw3610-with-custom-studio-rpc
      remote: cormoran
      revision: 5c34ea0eec246a1c986111417cd779b53144629a  # track: main
    - name: zmk-module-runtime-input-processor
      remote: cormoran
      revision: decf628d7ce5ed95b520c650824c28ea9de649c1  # track: main

    # ==== Connection タブ ====
    - name: zmk-module-ble-management
      remote: cormoran
      revision: 57738cc4fc6ba80e82a7ac57741a0339cb186cd4  # track: main
    # Studio から操作できる版は main ではなく下記ブランチにある
    - name: zmk-feature-default-layer
      remote: cormoran
      revision: b25cb5b324da2d9bbc84e1877c775f5b2b7c6845  # track: codex/custom-rpc-rewrite
    - name: zmk-feature-os-detection
      remote: cormoran
      revision: 3052679f645b8fc1997275c2eaa6b86bdd55ca01  # track: main

    # ==== Settings タブ ====
    - name: zmk-module-settings-rpc
      remote: cormoran
      revision: 78f86df9e6c5edaf57bef3ccbd7f360cfdf49291  # track: main
    # 電池履歴 (zmk-module-battery-history) は保存が遅い既知の問題があるため入れていない

    # ==== 診断と開発補助タブ ====
    - name: zmk-feature-kscan-diagnostics
      remote: cormoran
      revision: 1432f7fe0cfe903cd7d3c9931ae6bd6f2e1f328e  # track: main
    - name: zmk-feature-device-info
      remote: cormoran
      revision: 8cedd2dd9f04e19ea5a17b94914dd47a09d8db11  # track: main
    - name: zmk-feature-watchdog
      remote: cormoran
      revision: 84ad14c6c3645dc40b23f45d08ab45418655f912  # track: main
    - name: zmk-module-devtool
      remote: cormoran
      revision: 9938a2c73c06d6e65ba2c0b68c9aa044a467eafc  # track: main
    - name: zmk-feature-zephyr-setting-expose
      remote: cormoran
      revision: 5c89bc71122840ea46032fc241bef8665b99728a  # track: main
    - name: zmk-feature-studio-rpc-perf
      remote: cormoran
      revision: b6ccb08cdc46e9e6341b0c42b97f78f05df0939e  # track: main

    # ==== LED (バッテリー / 接続状態表示) ====
    - name: zmk-rgbled-widget
      remote: caksoylar
      revision: e6b467792a1dabef8cfa5c9fd26bfefc9c16662b  # track: main
  self:
    path: config
```
